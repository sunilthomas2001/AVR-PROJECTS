/*
 * OLED.c
 * SSD1306 OLED Driver
 * 128x64 I2C OLED Display
 */

#include "OLED.h"
#include "I2C.h"

/*
 * 5x7 ASCII Font
 *
 * Characters Included:
 * Space
 * Digits 0-9
 * Letters A-Z
 * Letters a-z
 * Colon :
 * Period .
 * Minus -
 */

const uint8_t font5x7[][5] =
{
    {0x00,0x00,0x00,0x00,0x00}, /* Space */

    {0x3E,0x51,0x49,0x45,0x3E}, /* 0 */
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    {0x08,0x08,0x08,0x08,0x08}  /* - */
};

/*
 * Send Command
 */
void OLED_Command(uint8_t cmd)
{
    I2C_Start();

    I2C_Write(OLED_ADDRESS << 1);

    I2C_Write(0x00);

    I2C_Write(cmd);

    I2C_Stop();
}

/*
 * Send Data
 */
void OLED_Data(uint8_t data)
{
    I2C_Start();

    I2C_Write(OLED_ADDRESS << 1);

    I2C_Write(0x40);

    I2C_Write(data);

    I2C_Stop();
}

/*
 * Initialize OLED
 */
void OLED_Init(void)
{
    OLED_Command(0xAE);

    OLED_Command(0xD5);
    OLED_Command(0x80);

    OLED_Command(0xA8);
    OLED_Command(0x3F);

    OLED_Command(0xD3);
    OLED_Command(0x00);

    OLED_Command(0x40);

    OLED_Command(0x8D);
    OLED_Command(0x14);

    OLED_Command(0x20);
    OLED_Command(0x00);

    OLED_Command(0xA1);

    OLED_Command(0xC8);

    OLED_Command(0xDA);
    OLED_Command(0x12);

    OLED_Command(0x81);
    OLED_Command(0xCF);

    OLED_Command(0xD9);
    OLED_Command(0xF1);

    OLED_Command(0xDB);
    OLED_Command(0x40);

    OLED_Command(0xA4);

    OLED_Command(0xA6);

    OLED_Command(0xAF);
}

/*
 * Clear Display
 */

void OLED_Clear(void)
{
	uint8_t page;
	uint8_t column;

	for(page = 0; page < 8; page++)
	{
		OLED_SetCursor(page, 0);

		for(column = 0; column < 128; column++)
		{
			OLED_Data(0x00);
		}
	}
}


/*
 * Set Cursor Position
 */
void OLED_SetCursor(uint8_t page,
                    uint8_t column)
{
    OLED_Command(0xB0 + page);

    OLED_Command(0x00 + (column & 0x0F));

    OLED_Command(0x10 + ((column >> 4) & 0x0F));
}

/*
 * Print One Character
 */
void OLED_PrintChar(char c)
{
    uint8_t i;

    if(c == ' ')
    {
        for(i=0;i<5;i++)
        {
            OLED_Data(0x00);
        }

        OLED_Data(0x00);

        return;
    }

    if(c >= '0' && c <= '9')
    {
        c = c - '0' + 1;
    }
    else if(c >= 'A' && c <= 'Z')
    {
        c = c - 'A' + 11;
    }
    else if(c == ':')
    {
        c = 37;
    }
    else if(c == '.')
    {
        c = 38;
    }
    else if(c == '-')
    {
        c = 39;
    }
    else
    {
        c = 0;
    }

    for(i=0;i<5;i++)
    {
        OLED_Data(font5x7[(uint8_t)c][i]);
    }

    OLED_Data(0x00);
}

/*
 * Print String
 */
void OLED_PrintString(char *str)
{
    while(*str)
    {
        OLED_PrintChar(*str);
        str++;
    }
}